## Config.in
```kconfig
if BR2_PACKAGE_PYTHON || BR2_PACKAGE_PYTHON3
menu "External python modules"
	source "package/python-debugpy/Config.in"
	source "package/python-httptools/Config.in"
	source "package/python-pca9685/Config.in"
	source "package/python-ptvsd/Config.in"
	source "package/python-rpyc/Config.in"
	source "package/python-sanic/Config.in"
	source "package/python-sanicrouting/Config.in"
endmenu
```

## python-debugpy/Config.in
```kconfig
config BR2_PACKAGE_PYTHON_DEBUGPY
	bool "python-debugpy"
	help
	  An implementation of the Debug Adapter Protocol for Python

	  https://github.com/microsoft/debugpy/
```

## python-html5tagger/Config.in
```kconfig
config BR2_PACKAGE_PYTHON_HTML5TAGGER
	bool "python-html5tagger"
	help
	  HTML5 Generation with html5tagger: Fast, Pure Python, No Dependencies

	  https://github.com/sanic-org/html5tagger
```

## python-pca9685/Config.in
```kconfig
config BR2_PACKAGE_PYTHON_PCA9685
	bool "python-pca9685"
	select BR2_PACKAGE_PYTHON_SMBUS_CFFI
	help
	  Python driver module for PCA9685 pwm (LED/Servo) controller

	  https://github.com/voidpp/PCA9685-driver
```

## python-rpyc/Config.in
```kconfig
config BR2_PACKAGE_PYTHON_RPYC
	bool "python-rpyc"
	help
	  RPyC (Remote Python Call) - A transparent and symmetric RPC library for python

	  https://github.com/tomerfiliba-org/rpyc
```

## python-sanic/Config.in
```kconfig
config BR2_PACKAGE_PYTHON_SANIC
	bool "python-sanic"
	select BR2_PACKAGE_PYTHON_SANICROUTING
	select BR2_PACKAGE_PYTHON_HTTPTOOLS
	select BR2_PACKAGE_PYTHON_HTML5TAGGER
	select BR2_PACKAGE_PYTHON_TRACERITE
	select BR2_PACKAGE_PYTHON_TYPING_EXTENSIONS
	select BR2_PACKAGE_PYTHON_MULTIDICT
	select BR2_PACKAGE_PYTHON_UVLOOP
	select BR2_PACKAGE_PYTHON_UJSON
	select BR2_PACKAGE_PYTHON_AIOFILES
	select BR2_PACKAGE_PYTHON_WEBSOCKETS
	  A web server and web framework that's written to go fast.
	  Build fast. Run fast.

	  http://github.com/sanic-org/sanic/
```

## python-sanicrouting/Config.in
```kconfig
config BR2_PACKAGE_PYTHON_SANICROUTING
	bool "python-sanicrouting"
	help
	  Internal handler routing for Sanic.

	  https://github.com/sanic-org/sanic-routing/
```

## python-tracerite/Config.in
```kconfig
config BR2_PACKAGE_PYTHON_TRACERITE
	bool "python-tracerite"
	select BR2_PACKAGE_PYTHON_HTML5TAGGER
	help
	  Nicer error messages for Python

	  https://github.com/sanic-org/tracerite
```
